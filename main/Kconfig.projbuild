## main/Kconfig.projbuild
```kconfig
menu "vl53l1x Test Configuration"

config SSID
    string "WIFI access point name (SSID)"
    default "hachidori_ap"
    help
        Enter the name of the WIFI access point

config SSID_PASSWORD
    string "WIFI password"
    default "e15f44ecdff3a"
    help
        Enter ssid password

config UDP_SERVER_ADDRESS
    string "IPv4 address of UDP server"
    default "192.168.11.1"
    help
        IP address of the UDP server, normaly same with AP_ADDRESS

config UDP_PORT
    int "UDP port"
    default 5390
    help
        UDP port used for both Wi-Fi and ether

config I2C_NUM
    int "I2C NUM"
    default 0
    help
	I2C unit number

config SCL_IO
    int "SCL GPIO NUM"
    default 26
    help
	GPIO pin for I2C SCL

config SDA_IO
    int "SDA GPIO NUM"
    default 25
    help
	GPIO pin for I2C SDA

config XSHUT_IO
    int "XSHUT GPIO NUM"
    default 27
    help
	GPIO pin for VL53L1X XSHUT

endmenu
```
